## lvgl_music_player/modules/nrf_ble_hids/Kconfig
```kconfig
# SPDX-License-Identifier: LicenseRef-Nordic-5-Clause

menu "Local Nordic BLE HIDS"

if BT

rsource "subsys/bluetooth/Kconfig.pool"
rsource "subsys/bluetooth/Kconfig.link"
rsource "subsys/bluetooth/services/Kconfig"

endif # BT

endmenu
```

## lvgl_music_player/modules/nrf_ble_hids/subsys/bluetooth/services/Kconfig
```kconfig
# SPDX-License-Identifier: LicenseRef-Nordic-5-Clause

menu "Bluetooth Services"

config BT_NRF_SERVICES
	bool
	help
	  Common Bluetooth GATT Services support modules.

rsource "Kconfig.hids"

endmenu
```
