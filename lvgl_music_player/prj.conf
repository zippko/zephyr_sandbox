## CMakeLists.txt
```
# SPDX-License-Identifier: Apache-2.0

cmake_minimum_required(VERSION 3.20.0)

# Use vendored Nordic BLE HIDS module from this repository.
list(APPEND ZEPHYR_EXTRA_MODULES
  "${CMAKE_CURRENT_SOURCE_DIR}/modules/nrf_ble_hids"
)
set(CONF_FILE "prj.conf;prj_ncs_hids.conf")

find_package(Zephyr REQUIRED HINTS $ENV{ZEPHYR_BASE})
project(lvgl_music_player)

target_sources(app PRIVATE
  src/main.c
  src/bluetooth_ctrl.c
  src/ui_scale.c
  src/picture1_bg.c
  src/ui_screens.c
  src/screen_menu.c
  src/screen_bluetooth.c
  src/screen_music_player.c
)
```

## prj.conf
```kconfig
CONFIG_MAIN_STACK_SIZE=4096

CONFIG_LOG=y
CONFIG_SHELL=n
CONFIG_INPUT_LOG_LEVEL_OFF=y

CONFIG_DISPLAY=y
CONFIG_DISPLAY_LOG_LEVEL_ERR=n

CONFIG_PWM=y

CONFIG_LVGL=y
CONFIG_LV_USE_LOG=y
CONFIG_LV_ATTRIBUTE_MEM_ALIGN_SIZE=4
CONFIG_LV_Z_MEM_POOL_SIZE=65536
CONFIG_LV_Z_SHELL=n
CONFIG_LV_Z_RUN_LVGL_ON_WORKQUEUE=y
CONFIG_LV_USE_LABEL=y
CONFIG_LV_USE_ARC=y
CONFIG_LV_USE_IMAGE=y
CONFIG_LV_USE_MONKEY=y
CONFIG_LV_FONT_MONTSERRAT_14=y
CONFIG_LV_FONT_MONTSERRAT_16=y
CONFIG_LV_FONT_MONTSERRAT_24=y
CONFIG_LV_FONT_MONTSERRAT_28=y
CONFIG_LV_FONT_MONTSERRAT_32=y
CONFIG_LV_FONT_MONTSERRAT_40=y
CONFIG_LV_FONT_MONTSERRAT_48=y
CONFIG_LV_USE_SYSMON=y
CONFIG_LV_USE_PERF_MONITOR=y
# CONFIG_LV_USE_MEM_MONITOR=y
CONFIG_LV_PERF_MONITOR_ALIGN_BOTTOM_MID=y
# CONFIG_LV_MEM_MONITOR_ALIGN_TOP_MID=y
 
```

## prj_ncs_hids.conf
```kconfig
CONFIG_BT=y
CONFIG_BT_MAX_CONN=2
CONFIG_BT_MAX_PAIRED=2
CONFIG_BT_SMP=y
CONFIG_BT_ATT_TX_COUNT=5
CONFIG_BT_PERIPHERAL=y
CONFIG_BT_DEVICE_NAME="Music_Controller"
CONFIG_BT_DEVICE_APPEARANCE=960
CONFIG_BT_GATT_AUTO_SEC_REQ=n
CONFIG_BT_AUTO_PHY_UPDATE=n
CONFIG_BT_SECURITY_ERR_TO_STR=y
CONFIG_BT_HIDS=y
CONFIG_BT_HIDS_MAX_CLIENT_COUNT=2
CONFIG_BT_HIDS_DEFAULT_PERM_RW_ENCRYPT=y
CONFIG_BT_GATT_UUID16_POOL_SIZE=40
CONFIG_BT_GATT_CHRC_POOL_SIZE=20
CONFIG_BT_CONN_CTX=y
CONFIG_BT_DIS=y
CONFIG_BT_DIS_MANUF_NAME=y
CONFIG_BT_DIS_MANUF_NAME_STR="LVGLMusicController"
CONFIG_BT_DIS_PNP=y
CONFIG_BT_DIS_PNP_VID_SRC=1
CONFIG_BT_DIS_PNP_VID=0x0000
CONFIG_BT_DIS_PNP_PID=0x0001
CONFIG_BT_DIS_PNP_VER=0x0100
CONFIG_BT_SETTINGS=y
CONFIG_SETTINGS=y
CONFIG_NVS=y
CONFIG_SETTINGS_NVS=y
CONFIG_FLASH=y
CONFIG_FLASH_PAGE_LAYOUT=y
CONFIG_FLASH_MAP=y
CONFIG_SYSTEM_WORKQUEUE_STACK_SIZE=4096
CONFIG_BT_RX_STACK_SIZE=4096
```

## boards/esp32s3_touch_lcd_1_28.overlay
```dts
/ {
    aliases {
        backlight = &pwm_lcd0;
    };
};
```

## src/main.c
```c
// SPDX-License-Identifier: Apache-2.0

#include <zephyr/device.h>
#include <zephyr/devicetree.h>
#include <zephyr/drivers/display.h>
#include <zephyr/drivers/pwm.h>
#include <zephyr/kernel.h>
#include <zephyr/logging/log.h>
#include <zephyr/sys/util.h>
#include <lvgl.h>
#include <lvgl_zephyr.h>

#include "bluetooth_ctrl.h"
#include "screen_music_player.h"
#include "ui_screens.h"

LOG_MODULE_REGISTER(lvgl_music_player, LOG_LEVEL_INF);

/* Use the board's pwm-leds backlight node directly. */
#define BACKLIGHT_NODE DT_NODELABEL(pwm_lcd0)

#if DT_NODE_EXISTS(BACKLIGHT_NODE) && DT_NODE_HAS_STATUS(BACKLIGHT_NODE, okay)
#define HAS_BACKLIGHT_NODE 1
static const struct pwm_dt_spec backlight = PWM_DT_SPEC_GET(BACKLIGHT_NODE);
#else
#define HAS_BACKLIGHT_NODE 0
#endif

int main(void)
{
#if HAS_BACKLIGHT_NODE
	uint32_t backlight_period;
#endif
	const struct device *display_dev = DEVICE_DT_GET(DT_CHOSEN(zephyr_display));
	int err;

	ui_screens_init(bt_ctrl_request_enabled, bt_ctrl_is_ready);
	ui_screen_music_player_init(bt_ctrl_send_play_pause, bt_ctrl_send_usage,
				    bt_ctrl_is_connected);
	bt_ctrl_init(ui_screens_show_pairing_passkey, ui_screens_hide_pairing_passkey);

#if HAS_BACKLIGHT_NODE
	/* Turn on backlight if the board exposes it through pwm-leds. */
	if (!device_is_ready(backlight.dev)) {
		LOG_WRN("Backlight PWM device is not ready");
	} else {
		backlight_period = backlight.period;
		if (backlight_period == 0U) {
			backlight_period = PWM_USEC(4000);
		}

		if (pwm_set_dt(&backlight, backlight_period,
			       backlight_period / 2U) != 0) {
			LOG_WRN("Failed to enable backlight PWM");
		}
	}
#else
	LOG_INF("No pwm_lcd0 backlight node in board definition");
#endif

	if (!device_is_ready(display_dev)) {
		LOG_ERR("Display device is not ready");
		return 0;
	}

	/* Wait for display init. */
	k_sleep(K_MSEC(200));

	if (display_blanking_off(display_dev) != 0) {
		LOG_WRN("Could not unblank display");
	}

	err = bt_ctrl_enable_stack_and_start();
	if (err) {
		LOG_WRN("Bluetooth controller init/start failed (err %d)", err);
	}

	lvgl_lock();
	ui_screens_show_default();
#ifndef CONFIG_LV_Z_RUN_LVGL_ON_WORKQUEUE
	lv_timer_handler();
#endif
	lvgl_unlock();

	LOG_INF("Default radial menu screen started");

	while (1) {
#ifndef CONFIG_LV_Z_RUN_LVGL_ON_WORKQUEUE
		uint32_t sleep_ms;

		lvgl_lock();
		sleep_ms = lv_timer_handler();
		lvgl_unlock();

		if (sleep_ms == LV_NO_TIMER_READY || sleep_ms > 100U) {
			sleep_ms = 10U;
		}

		k_sleep(K_MSEC(sleep_ms));
#else
		k_sleep(K_MSEC(10));
#endif
	}

	return 0;
}
```

## src/bluetooth_ctrl.c
```c
// SPDX-License-Identifier: Apache-2.0

#include "bluetooth_ctrl.h"

#include <errno.h>
#include <zephyr/kernel.h>
#include <zephyr/logging/log.h>

#if __has_include(<bluetooth/services/hids.h>)
#define HAS_NRF_HIDS 1
#include <zephyr/settings/settings.h>
#include <zephyr/bluetooth/bluetooth.h>
#include <zephyr/bluetooth/conn.h>
#include <zephyr/bluetooth/hci.h>
#include <zephyr/bluetooth/uuid.h>
#include <bluetooth/services/hids.h>
#else
#define HAS_NRF_HIDS 0
#endif

LOG_MODULE_REGISTER(bluetooth_ctrl, LOG_LEVEL_INF);

#if HAS_NRF_HIDS
#define OUTPUT_REPORT_MAX_LEN 0
#define INPUT_REP_MEDIA_REF_ID 1
#define INPUT_REPORT_MEDIA_MAX_LEN 2
#define HID_CONSUMER_PLAY 0x00B0
#define HID_CONSUMER_PAUSE 0x00B1

enum {
	INPUT_REP_MEDIA_IDX = 0
};

BT_HIDS_DEF(hids_obj, OUTPUT_REPORT_MAX_LEN, INPUT_REPORT_MEDIA_MAX_LEN);

static const struct bt_data ad[] = {
	BT_DATA_BYTES(BT_DATA_GAP_APPEARANCE,
		      (CONFIG_BT_DEVICE_APPEARANCE >> 0) & 0xff,
		      (CONFIG_BT_DEVICE_APPEARANCE >> 8) & 0xff),
	BT_DATA_BYTES(BT_DATA_FLAGS, (BT_LE_AD_GENERAL | BT_LE_AD_NO_BREDR)),
	BT_DATA_BYTES(BT_DATA_UUID16_ALL, BT_UUID_16_ENCODE(BT_UUID_HIDS_VAL)),
};

static const struct bt_data sd[] = {
	BT_DATA(BT_DATA_NAME_COMPLETE, CONFIG_BT_DEVICE_NAME,
		sizeof(CONFIG_BT_DEVICE_NAME) - 1),
};

struct conn_mode {
	struct bt_conn *conn;
	bool reserved;
};

static struct conn_mode conn_mode[CONFIG_BT_HIDS_MAX_CLIENT_COUNT];
static bool bluetooth_ready;
static bool bluetooth_target_enabled;
static struct k_work bluetooth_setting_work;
static bt_ctrl_show_passkey_cb_t show_passkey_cb;
static bt_ctrl_hide_passkey_cb_t hide_passkey_cb;

static int advertising_start(void)
{
	int err;
	const struct bt_le_adv_param *adv_param = BT_LE_ADV_PARAM(
		BT_LE_ADV_OPT_CONN, BT_GAP_ADV_FAST_INT_MIN_2,
		BT_GAP_ADV_FAST_INT_MAX_2, NULL);

	err = bt_le_adv_start(adv_param, ad, ARRAY_SIZE(ad), sd, ARRAY_SIZE(sd));
	if (err && err != -EALREADY) {
		LOG_ERR("Advertising failed (err %d)", err);
		return err;
	}

	LOG_INF("Advertising started");
	return 0;
}

static void connected(struct bt_conn *conn, uint8_t err)
{
	char addr[BT_ADDR_LE_STR_LEN];

	bt_addr_le_to_str(bt_conn_get_dst(conn), addr, sizeof(addr));

	if (err) {
		LOG_WRN("Connect failed to %s (0x%02x)", addr, err);
		return;
	}

	for (size_t i = 0; i < CONFIG_BT_HIDS_MAX_CLIENT_COUNT; i++) {
		if (!conn_mode[i].conn) {
			conn_mode[i].conn = conn;
			conn_mode[i].reserved = false;
			break;
		}
	}

	err = bt_hids_connected(&hids_obj, conn);
	if (err) {
		LOG_WRN("bt_hids_connected failed (err %d)", err);
	}

	LOG_INF("Connected %s", addr);
}

static void disconnected(struct bt_conn *conn, uint8_t reason)
{
	int err;

	err = bt_hids_disconnected(&hids_obj, conn);
	if (err) {
		LOG_WRN("bt_hids_disconnected failed (err %d)", err);
	}

	for (size_t i = 0; i < CONFIG_BT_HIDS_MAX_CLIENT_COUNT; i++) {
		if (conn_mode[i].conn == conn) {
			conn_mode[i].conn = NULL;
			conn_mode[i].reserved = false;
			break;
		}
	}

	LOG_INF("Disconnected (reason 0x%02x)", reason);
	if (hide_passkey_cb != NULL) {
		hide_passkey_cb();
	}
	if (bluetooth_ready) {
		(void)advertising_start();
	}
}

static void security_changed(struct bt_conn *conn, bt_security_t level,
			     enum bt_security_err err)
{
	char addr[BT_ADDR_LE_STR_LEN];

	bt_addr_le_to_str(bt_conn_get_dst(conn), addr, sizeof(addr));
	if (err) {
		LOG_WRN("Security failed for %s level %u err %d (%s)", addr, level,
			err, bt_security_err_to_str(err));
	} else {
		LOG_INF("Security changed for %s level %u", addr, level);
	}
}

BT_CONN_CB_DEFINE(conn_callbacks) = {
	.connected = connected,
	.disconnected = disconnected,
	.security_changed = security_changed,
};

static void hids_pm_evt_handler(enum bt_hids_pm_evt evt, struct bt_conn *conn)
{
	ARG_UNUSED(evt);
	ARG_UNUSED(conn);
}

static void hid_init(void)
{
	int err;
	struct bt_hids_init_param hids_init_obj = { 0 };
	struct bt_hids_inp_rep *hids_inp_rep;
	static const uint8_t report_map[] = {
		0x05, 0x0C, 0x09, 0x01, 0xA1, 0x01, 0x85, INPUT_REP_MEDIA_REF_ID,
		0x15, 0x00, 0x26, 0xFF, 0x03, 0x19, 0x00, 0x2A, 0xFF, 0x03,
		0x75, 0x10, 0x95, 0x01, 0x81, 0x00, 0xC0
	};

	hids_init_obj.rep_map.data = report_map;
	hids_init_obj.rep_map.size = sizeof(report_map);
	hids_init_obj.info.bcd_hid = 0x0101;
	hids_init_obj.info.b_country_code = 0x00;
	hids_init_obj.info.flags = (BT_HIDS_REMOTE_WAKE |
				    BT_HIDS_NORMALLY_CONNECTABLE);

	hids_inp_rep =
		&hids_init_obj.inp_rep_group_init.reports[INPUT_REP_MEDIA_IDX];
	hids_inp_rep->size = INPUT_REPORT_MEDIA_MAX_LEN;
	hids_inp_rep->id = INPUT_REP_MEDIA_REF_ID;
	hids_init_obj.inp_rep_group_init.cnt++;

	hids_init_obj.is_kb = false;
	hids_init_obj.is_mouse = false;
	hids_init_obj.pm_evt_handler = hids_pm_evt_handler;

	err = bt_hids_init(&hids_obj, &hids_init_obj);
	if (err) {
		LOG_ERR("HIDS init failed (err %d)", err);
	} else {
		LOG_INF("HIDS initialized");
	}
}

static void auth_passkey_display(struct bt_conn *conn, unsigned int passkey)
{
	char addr[BT_ADDR_LE_STR_LEN];

	bt_addr_le_to_str(bt_conn_get_dst(conn), addr, sizeof(addr));
	LOG_INF("Passkey for %s: %06u", addr, passkey);
	if (show_passkey_cb != NULL) {
		show_passkey_cb(passkey);
	}
}

static void auth_passkey_confirm(struct bt_conn *conn, unsigned int passkey)
{
	char addr[BT_ADDR_LE_STR_LEN];
	int err;

	bt_addr_le_to_str(bt_conn_get_dst(conn), addr, sizeof(addr));
	LOG_INF("Confirming passkey for %s: %06u", addr, passkey);
	if (show_passkey_cb != NULL) {
		show_passkey_cb(passkey);
	}

	err = bt_conn_auth_passkey_confirm(conn);
	if (err) {
		LOG_WRN("Passkey confirm failed (err %d)", err);
	}
}

static void auth_cancel(struct bt_conn *conn)
{
	char addr[BT_ADDR_LE_STR_LEN];

	bt_addr_le_to_str(bt_conn_get_dst(conn), addr, sizeof(addr));
	LOG_WRN("Pairing cancelled: %s", addr);
	if (hide_passkey_cb != NULL) {
		hide_passkey_cb();
	}
}

static void pairing_complete(struct bt_conn *conn, bool bonded)
{
	char addr[BT_ADDR_LE_STR_LEN];

	bt_addr_le_to_str(bt_conn_get_dst(conn), addr, sizeof(addr));
	LOG_INF("Pairing completed: %s, bonded: %d", addr, bonded);
	if (hide_passkey_cb != NULL) {
		hide_passkey_cb();
	}
}

static void pairing_failed(struct bt_conn *conn, enum bt_security_err reason)
{
	char addr[BT_ADDR_LE_STR_LEN];

	bt_addr_le_to_str(bt_conn_get_dst(conn), addr, sizeof(addr));
	LOG_WRN("Pairing failed: %s, reason %d (%s)", addr, reason,
		bt_security_err_to_str(reason));
	if (hide_passkey_cb != NULL) {
		hide_passkey_cb();
	}
}

static struct bt_conn_auth_cb conn_auth_callbacks = {
	.passkey_display = auth_passkey_display,
	.passkey_confirm = auth_passkey_confirm,
	.cancel = auth_cancel,
};

static struct bt_conn_auth_info_cb conn_auth_info_callbacks = {
	.pairing_complete = pairing_complete,
	.pairing_failed = pairing_failed,
};

static int send_consumer_usage(uint16_t usage)
{
	uint8_t report[INPUT_REPORT_MEDIA_MAX_LEN];
	bool has_conn = false;
	int err;

	report[0] = (uint8_t)(usage & 0xFFU);
	report[1] = (uint8_t)(usage >> 8);

	for (size_t i = 0; i < CONFIG_BT_HIDS_MAX_CLIENT_COUNT; i++) {
		if (!conn_mode[i].conn) {
			continue;
		}
		has_conn = true;
		err = bt_hids_inp_rep_send(&hids_obj, conn_mode[i].conn,
					   INPUT_REP_MEDIA_IDX, report,
					   sizeof(report), NULL);
		if (err) {
			return err;
		}
	}

	return has_conn ? 0 : -ENOTCONN;
}

static void apply_bluetooth_enabled(bool enabled)
{
	int err;

	if (enabled) {
		if (bluetooth_ready) {
			return;
		}
		bluetooth_ready = true;
		err = advertising_start();
		if (err) {
			bluetooth_ready = false;
			LOG_WRN("Failed to enable Bluetooth advertising (err %d)", err);
		} else {
			LOG_INF("Bluetooth enabled");
		}
		return;
	}

	if (!bluetooth_ready) {
		return;
	}

	bluetooth_ready = false;
	err = bt_le_adv_stop();
	if (err && err != -EALREADY) {
		LOG_WRN("Failed to stop advertising (err %d)", err);
	}

	for (size_t i = 0; i < CONFIG_BT_HIDS_MAX_CLIENT_COUNT; i++) {
		if (!conn_mode[i].conn) {
			continue;
		}
		err = bt_conn_disconnect(conn_mode[i].conn,
					 BT_HCI_ERR_REMOTE_USER_TERM_CONN);
		if (err) {
			LOG_WRN("Failed to disconnect peer (err %d)", err);
		}
	}

	LOG_INF("Bluetooth disabled");
}

static void bluetooth_setting_work_handler(struct k_work *work)
{
	ARG_UNUSED(work);
	apply_bluetooth_enabled(bluetooth_target_enabled);
}
#endif /* HAS_NRF_HIDS */

void bt_ctrl_init(bt_ctrl_show_passkey_cb_t show_cb,
		  bt_ctrl_hide_passkey_cb_t hide_cb)
{
#if HAS_NRF_HIDS
	show_passkey_cb = show_cb;
	hide_passkey_cb = hide_cb;
	k_work_init(&bluetooth_setting_work, bluetooth_setting_work_handler);
	bluetooth_target_enabled = true;
#else
	ARG_UNUSED(show_cb);
	ARG_UNUSED(hide_cb);
#endif
}

int bt_ctrl_enable_stack_and_start(void)
{
#if HAS_NRF_HIDS
	int err;

	err = bt_conn_auth_cb_register(&conn_auth_callbacks);
	if (err) {
		LOG_ERR("Failed to register auth callbacks (err %d)", err);
		return err;
	}

	err = bt_conn_auth_info_cb_register(&conn_auth_info_callbacks);
	if (err) {
		LOG_ERR("Failed to register auth info callbacks (err %d)", err);
		return err;
	}

	hid_init();

	err = bt_enable(NULL);
	if (err) {
		LOG_ERR("Bluetooth init failed (err %d)", err);
		return err;
	}

	bluetooth_ready = true;
	bluetooth_target_enabled = true;
	LOG_INF("Bluetooth initialized");

	if (IS_ENABLED(CONFIG_SETTINGS)) {
		settings_load();
	}

	err = advertising_start();
	if (err) {
		LOG_WRN("Initial advertising start failed (err %d)", err);
	}
	return err;
#else
	LOG_WRN("BLE HIDS is unavailable in this Zephyr workspace");
	return -ENOTSUP;
#endif
}

void bt_ctrl_request_enabled(bool enabled)
{
#if HAS_NRF_HIDS
	bluetooth_target_enabled = enabled;
	k_work_submit(&bluetooth_setting_work);
#else
	ARG_UNUSED(enabled);
#endif
}

bool bt_ctrl_is_ready(void)
{
#if HAS_NRF_HIDS
	return bluetooth_ready;
#else
	return false;
#endif
}

bool bt_ctrl_is_connected(void)
{
#if HAS_NRF_HIDS
	for (size_t i = 0; i < CONFIG_BT_HIDS_MAX_CLIENT_COUNT; i++) {
		if (conn_mode[i].conn != NULL) {
			return true;
		}
	}
	return false;
#else
	return false;
#endif
}

int bt_ctrl_send_play_pause(bool play)
{
#if HAS_NRF_HIDS
	uint16_t usage = play ? HID_CONSUMER_PLAY : HID_CONSUMER_PAUSE;
	int err;

	err = send_consumer_usage(usage);
	if (err && err != -ENOTCONN) {
		return err;
	}

	err = send_consumer_usage(0U);
	if (err && err != -ENOTCONN) {
		return err;
	}

	return 0;
#else
	ARG_UNUSED(play);
	return -ENOTSUP;
#endif
}

int bt_ctrl_send_usage(uint16_t usage)
{
#if HAS_NRF_HIDS
	int err;

	err = send_consumer_usage(usage);
	if (err && err != -ENOTCONN) {
		return err;
	}
	err = send_consumer_usage(0U);
	if (err && err != -ENOTCONN) {
		return err;
	}
	return 0;
#else
	ARG_UNUSED(usage);
	return -ENOTSUP;
#endif
}
```

## src/bluetooth_ctrl.h
```c
// SPDX-License-Identifier: Apache-2.0

#ifndef BLUETOOTH_CTRL_H_
#define BLUETOOTH_CTRL_H_

#include <stdbool.h>
#include <stdint.h>

typedef void (*bt_ctrl_show_passkey_cb_t)(unsigned int passkey);
typedef void (*bt_ctrl_hide_passkey_cb_t)(void);

void bt_ctrl_init(bt_ctrl_show_passkey_cb_t show_passkey_cb,
		  bt_ctrl_hide_passkey_cb_t hide_passkey_cb);
int bt_ctrl_enable_stack_and_start(void);
void bt_ctrl_request_enabled(bool enabled);
bool bt_ctrl_is_ready(void);
bool bt_ctrl_is_connected(void);
int bt_ctrl_send_play_pause(bool play);
int bt_ctrl_send_usage(uint16_t usage);

#endif /* BLUETOOTH_CTRL_H_ */
```

## src/screen_bluetooth.c
```c
// SPDX-License-Identifier: Apache-2.0

#include "screen_bluetooth.h"

#include <lvgl.h>

#include "screen_menu.h"
#include "ui_scale.h"
#include "ui_screens.h"

LV_IMAGE_DECLARE(picture1_bg);

static void bluetooth_switch_event_cb(lv_event_t *e)
{
	lv_obj_t *sw;

	if (lv_event_get_code(e) != LV_EVENT_VALUE_CHANGED) {
		return;
	}

	sw = lv_event_get_target(e);
	ui_screens_request_bluetooth_enabled(lv_obj_has_state(sw, LV_STATE_CHECKED));
}

static void show_default_screen_async(void *user_data)
{
	ARG_UNUSED(user_data);
	ui_screen_menu_set_focus(UI_MENU_IDX_BLUETOOTH);
	ui_screens_show_default();
}

static void screen_nav_gesture_event_cb(lv_event_t *e)
{
	lv_indev_t *indev = lv_indev_active();

	ARG_UNUSED(e);

	if (ui_screens_get_active() != UI_SCREEN_BLUETOOTH) {
		return;
	}

	if (indev == NULL) {
		return;
	}

	if (lv_indev_get_gesture_dir(indev) == LV_DIR_TOP) {
		lv_async_call(show_default_screen_async, NULL);
	}
}

void ui_screen_bluetooth_show(void)
{
	lv_obj_t *scr = lv_screen_active();
	lv_obj_t *bg_img;
	lv_obj_t *row;
	lv_obj_t *label;
	lv_obj_t *sw;

	lv_obj_clean(scr);
	ui_scale_refresh_for_active_screen();
	ui_screens_set_active(UI_SCREEN_BLUETOOTH);
	ui_screens_clear_pairing_overlay();

	lv_obj_set_style_bg_color(scr, lv_color_hex(0x000000), LV_PART_MAIN);
	lv_obj_set_style_bg_grad_color(scr, lv_color_hex(0x000000), LV_PART_MAIN);
	lv_obj_set_style_bg_grad_dir(scr, LV_GRAD_DIR_NONE, LV_PART_MAIN);
	lv_obj_set_style_border_width(scr, 0, LV_PART_MAIN);
	lv_obj_add_event_cb(scr, screen_nav_gesture_event_cb, LV_EVENT_GESTURE, NULL);

	bg_img = lv_image_create(scr);
	lv_image_set_src(bg_img, &picture1_bg);
	lv_obj_set_size(bg_img, lv_pct(100), lv_pct(100));
	lv_image_set_inner_align(bg_img, LV_IMAGE_ALIGN_COVER);
	lv_obj_set_style_image_opa(bg_img, LV_OPA_50, LV_PART_MAIN);
	lv_obj_center(bg_img);

	row = lv_obj_create(scr);
	lv_obj_set_size(row, ui_scale_px(160), ui_scale_px(56));
	lv_obj_align(row, LV_ALIGN_CENTER, 0, ui_scale_px(8));
	lv_obj_set_style_radius(row, ui_scale_px(14), LV_PART_MAIN);
	lv_obj_set_style_bg_color(row, lv_color_hex(0x000000), LV_PART_MAIN);
	lv_obj_set_style_bg_opa(row, LV_OPA_40, LV_PART_MAIN);
	lv_obj_set_style_border_width(row, ui_scale_px(1), LV_PART_MAIN);
	lv_obj_set_style_border_color(row, lv_color_hex(0x6F839A), LV_PART_MAIN);
	lv_obj_set_style_pad_hor(row, ui_scale_px(12), LV_PART_MAIN);
	lv_obj_set_style_pad_ver(row, ui_scale_px(10), LV_PART_MAIN);
	lv_obj_remove_flag(row, LV_OBJ_FLAG_SCROLLABLE);

	label = lv_label_create(row);
	lv_label_set_text(label, "Bluetooth");
	lv_obj_set_style_text_font(label, ui_scale_font_montserrat(14),
				   LV_PART_MAIN);
	lv_obj_set_style_text_color(label, lv_color_hex(0xDCE8F2), LV_PART_MAIN);
	lv_obj_align(label, LV_ALIGN_LEFT_MID, 0, 0);

	sw = lv_switch_create(row);
	if (ui_screens_is_bluetooth_enabled()) {
		lv_obj_add_state(sw, LV_STATE_CHECKED);
	} else {
		lv_obj_remove_state(sw, LV_STATE_CHECKED);
	}
	lv_obj_align(sw, LV_ALIGN_RIGHT_MID, 0, 0);
	lv_obj_add_event_cb(sw, bluetooth_switch_event_cb, LV_EVENT_VALUE_CHANGED,
			    NULL);
}
```

## src/screen_bluetooth.h
```c
// SPDX-License-Identifier: Apache-2.0

#ifndef SCREEN_BLUETOOTH_H_
#define SCREEN_BLUETOOTH_H_

void ui_screen_bluetooth_show(void);

#endif /* SCREEN_BLUETOOTH_H_ */
```

## src/screen_menu.c
```c
// SPDX-License-Identifier: Apache-2.0

#include "screen_menu.h"

#include <zephyr/kernel.h>
#include <lvgl.h>

#include "screen_bluetooth.h"
#include "screen_music_player.h"
#include "ui_scale.h"
#include "ui_screens.h"

LV_IMAGE_DECLARE(picture1_bg);

#define RADIAL_MENU_ITEMS_COUNT 6
#define RADIAL_MENU_ITEM_SIZE 50
#define RADIAL_MENU_ZOOM_NORMAL 256
#define RADIAL_MENU_ZOOM_ACTIVE 307
#define GESTURE_RATE_LIMIT_MS 350
#define MENU_LABEL_FADE_MS 160

struct radial_menu_item {
	const char *symbol;
	const char *label;
};

static const struct radial_menu_item radial_menu_items[RADIAL_MENU_ITEMS_COUNT] = {
	{ LV_SYMBOL_AUDIO, "Music" },
	{ LV_SYMBOL_VIDEO, "Video" },
	{ LV_SYMBOL_SETTINGS, "Settings" },
	{ LV_SYMBOL_BLUETOOTH, "Bluetooth" },
	{ LV_SYMBOL_FILE, "Storage" },
	{ LV_SYMBOL_POWER, "Power" },
};

static lv_obj_t *radial_menu_items_obj[RADIAL_MENU_ITEMS_COUNT];
static lv_obj_t *radial_menu_symbols_obj[RADIAL_MENU_ITEMS_COUNT];
static lv_obj_t *radial_menu_center_label;
static uint8_t radial_menu_active_idx;
static int32_t radial_menu_item_zoom[RADIAL_MENU_ITEMS_COUNT];
static int64_t last_gesture_action_ms;
static uint8_t radial_menu_label_idx;
static bool radial_menu_label_animating;
static bool radial_menu_label_pending;
static uint8_t radial_menu_label_pending_idx;

static bool radial_menu_is_ready(void)
{
	if ((radial_menu_center_label == NULL) ||
	    !lv_obj_is_valid(radial_menu_center_label)) {
		return false;
	}

	for (size_t i = 0; i < RADIAL_MENU_ITEMS_COUNT; i++) {
		if ((radial_menu_items_obj[i] == NULL) ||
		    (radial_menu_symbols_obj[i] == NULL) ||
		    !lv_obj_is_valid(radial_menu_items_obj[i]) ||
		    !lv_obj_is_valid(radial_menu_symbols_obj[i])) {
			return false;
		}
	}

	return true;
}

void ui_screen_menu_set_focus(uint8_t idx)
{
	radial_menu_active_idx = idx;
}

uint8_t ui_screen_menu_get_focus(void)
{
	return radial_menu_active_idx;
}

static void radial_menu_zoom_exec_cb(void *var, int32_t v)
{
	lv_obj_set_style_transform_zoom((lv_obj_t *)var, v, LV_PART_MAIN);
}

static void radial_menu_label_fade_exec_cb(void *var, int32_t v)
{
	ARG_UNUSED(var);
	lv_obj_set_style_text_opa(radial_menu_center_label, (lv_opa_t)v, LV_PART_MAIN);
}

static void radial_menu_start_label_animation(uint8_t target_idx);

static void radial_menu_label_fade_in_ready_cb(lv_anim_t *a)
{
	ARG_UNUSED(a);

	radial_menu_label_animating = false;
	if (radial_menu_label_pending &&
	    radial_menu_label_pending_idx != radial_menu_label_idx) {
		uint8_t next_idx = radial_menu_label_pending_idx;

		radial_menu_label_pending = false;
		radial_menu_start_label_animation(next_idx);
	}
}

static void radial_menu_label_fade_out_ready_cb(lv_anim_t *a)
{
	lv_anim_t fade_in_anim;

	ARG_UNUSED(a);

	radial_menu_label_idx = radial_menu_label_pending_idx;
	lv_label_set_text(radial_menu_center_label,
			  radial_menu_items[radial_menu_label_idx].label);

	lv_anim_init(&fade_in_anim);
	lv_anim_set_var(&fade_in_anim, NULL);
	lv_anim_set_values(&fade_in_anim, LV_OPA_TRANSP, LV_OPA_COVER);
	lv_anim_set_time(&fade_in_anim, MENU_LABEL_FADE_MS);
	lv_anim_set_exec_cb(&fade_in_anim, radial_menu_label_fade_exec_cb);
	lv_anim_set_ready_cb(&fade_in_anim, radial_menu_label_fade_in_ready_cb);
	lv_anim_start(&fade_in_anim);
}

static void radial_menu_start_label_animation(uint8_t target_idx)
{
	lv_anim_t fade_out_anim;

	if (!radial_menu_is_ready()) {
		return;
	}

	if (radial_menu_label_animating) {
		radial_menu_label_pending = true;
		radial_menu_label_pending_idx = target_idx;
		return;
	}

	if (target_idx == radial_menu_label_idx) {
		return;
	}

	radial_menu_label_animating = true;
	radial_menu_label_pending = true;
	radial_menu_label_pending_idx = target_idx;

	lv_anim_init(&fade_out_anim);
	lv_anim_set_var(&fade_out_anim, NULL);
	lv_anim_set_values(&fade_out_anim, LV_OPA_COVER, LV_OPA_TRANSP);
	lv_anim_set_time(&fade_out_anim, MENU_LABEL_FADE_MS);
	lv_anim_set_exec_cb(&fade_out_anim, radial_menu_label_fade_exec_cb);
	lv_anim_set_ready_cb(&fade_out_anim, radial_menu_label_fade_out_ready_cb);
	lv_anim_start(&fade_out_anim);
}

static void radial_menu_refresh(bool animate_label)
{
	lv_point_t slots[RADIAL_MENU_ITEMS_COUNT] = {
		{ 0, ui_scale_px(-74) },
		{ ui_scale_px(64), ui_scale_px(-37) },
		{ ui_scale_px(64), ui_scale_px(37) },
		{ 0, ui_scale_px(74) },
		{ ui_scale_px(-64), ui_scale_px(37) },
		{ ui_scale_px(-64), ui_scale_px(-37) },
	};
	int32_t border_w = ui_scale_px(1);

	if (!radial_menu_is_ready()) {
		return;
	}
	if (border_w < 1) {
		border_w = 1;
	}

	for (size_t i = 0; i < RADIAL_MENU_ITEMS_COUNT; i++) {
		bool active = (i == radial_menu_active_idx);
		lv_obj_t *obj = radial_menu_items_obj[i];
		int32_t from_zoom = radial_menu_item_zoom[i];
		int32_t to_zoom = active ? RADIAL_MENU_ZOOM_ACTIVE :
					  RADIAL_MENU_ZOOM_NORMAL;
		lv_anim_t anim;

		lv_anim_init(&anim);
		lv_anim_set_var(&anim, obj);
		lv_anim_set_values(&anim, from_zoom, to_zoom);
		lv_anim_set_time(&anim, 160);
		lv_anim_set_exec_cb(&anim, radial_menu_zoom_exec_cb);
		lv_anim_start(&anim);
		radial_menu_item_zoom[i] = to_zoom;

		lv_obj_align(obj, LV_ALIGN_CENTER, slots[i].x, slots[i].y);
		lv_obj_set_style_bg_opa(obj, active ? LV_OPA_TRANSP : LV_OPA_30,
					LV_PART_MAIN);
		lv_obj_set_style_bg_color(obj, lv_color_hex(0x12202E), LV_PART_MAIN);
		lv_obj_set_style_border_width(obj, border_w, LV_PART_MAIN);
		lv_obj_set_style_border_color(obj,
					      active ? lv_color_hex(0xE7EEFF) :
						       lv_color_hex(0x6F839A),
					      LV_PART_MAIN);
		lv_obj_set_style_text_color(radial_menu_symbols_obj[i],
					    active ? lv_color_hex(0xFFFFFF) :
						     lv_color_hex(0xD0DEEB),
					    LV_PART_MAIN);
	}

	if (animate_label) {
		radial_menu_start_label_animation(radial_menu_active_idx);
	} else {
		radial_menu_label_idx = radial_menu_active_idx;
		radial_menu_label_animating = false;
		radial_menu_label_pending = false;
		lv_obj_set_style_text_opa(radial_menu_center_label, LV_OPA_COVER,
					  LV_PART_MAIN);
		lv_label_set_text(radial_menu_center_label,
				  radial_menu_items[radial_menu_active_idx].label);
	}
}

static void default_screen_gesture_event_cb(lv_event_t *e)
{
	lv_indev_t *indev = lv_indev_active();
	lv_dir_t gesture_dir;
	int64_t now_ms;

	ARG_UNUSED(e);

	if (ui_screens_get_active() != UI_SCREEN_MENU) {
		return;
	}

	if (indev == NULL) {
		return;
	}
	if (!radial_menu_is_ready()) {
		return;
	}

	now_ms = k_uptime_get();
	if ((now_ms - last_gesture_action_ms) < GESTURE_RATE_LIMIT_MS) {
		return;
	}

	gesture_dir = lv_indev_get_gesture_dir(indev);
	if (gesture_dir == LV_DIR_LEFT) {
		radial_menu_active_idx =
			(uint8_t)((radial_menu_active_idx + 1) % RADIAL_MENU_ITEMS_COUNT);
		last_gesture_action_ms = now_ms;
		radial_menu_refresh(true);
	} else if (gesture_dir == LV_DIR_RIGHT) {
		radial_menu_active_idx = (uint8_t)((radial_menu_active_idx +
						    RADIAL_MENU_ITEMS_COUNT - 1) %
						   RADIAL_MENU_ITEMS_COUNT);
		last_gesture_action_ms = now_ms;
		radial_menu_refresh(true);
	}
}

static void radial_menu_item_event_cb(lv_event_t *e)
{
	lv_obj_t *target;

	if (lv_event_get_code(e) != LV_EVENT_CLICKED) {
		return;
	}

	target = lv_event_get_target(e);
	for (uint8_t i = 0; i < RADIAL_MENU_ITEMS_COUNT; i++) {
		if (radial_menu_items_obj[i] != target) {
			continue;
		}

		if (radial_menu_active_idx != i) {
			radial_menu_active_idx = i;
			radial_menu_refresh(true);
		} else if (i == UI_MENU_IDX_MUSIC) {
			ui_screen_music_player_show();
		} else if (i == UI_MENU_IDX_BLUETOOTH) {
			ui_screen_bluetooth_show();
		}
		break;
	}
}

void ui_screen_menu_build(lv_obj_t *scr, bool clean_first)
{
	lv_obj_t *bg_img;
	lv_obj_t *menu_ring;
	lv_obj_t *pairing_overlay;
	lv_obj_t *pairing_passkey_label;
	int32_t item_size;

	if (clean_first) {
		lv_obj_clean(scr);
	}
	ui_scale_refresh_for_active_screen();
	ui_screens_set_active(UI_SCREEN_MENU);
	ui_screens_clear_pairing_overlay();

	lv_obj_set_style_bg_color(scr, lv_color_hex(0x000000), LV_PART_MAIN);
	lv_obj_set_style_bg_grad_color(scr, lv_color_hex(0x000000), LV_PART_MAIN);
	lv_obj_set_style_bg_grad_dir(scr, LV_GRAD_DIR_NONE, LV_PART_MAIN);
	lv_obj_set_style_border_width(scr, 0, LV_PART_MAIN);
	lv_obj_add_event_cb(scr, default_screen_gesture_event_cb, LV_EVENT_GESTURE,
			    NULL);

	bg_img = lv_image_create(scr);
	lv_image_set_src(bg_img, &picture1_bg);
	lv_obj_set_size(bg_img, lv_pct(100), lv_pct(100));
	lv_image_set_inner_align(bg_img, LV_IMAGE_ALIGN_COVER);
	lv_obj_set_style_image_opa(bg_img, LV_OPA_50, LV_PART_MAIN);
	lv_obj_add_flag(bg_img, LV_OBJ_FLAG_GESTURE_BUBBLE);
	lv_obj_center(bg_img);

	menu_ring = lv_obj_create(scr);
	lv_obj_set_size(menu_ring, ui_scale_px(200), ui_scale_px(200));
	lv_obj_center(menu_ring);
	lv_obj_set_style_radius(menu_ring, LV_RADIUS_CIRCLE, LV_PART_MAIN);
	lv_obj_set_style_bg_opa(menu_ring, LV_OPA_10, LV_PART_MAIN);
	lv_obj_set_style_bg_color(menu_ring, lv_color_hex(0x000000), LV_PART_MAIN);
	lv_obj_set_style_border_width(menu_ring, 0, LV_PART_MAIN);
	lv_obj_set_style_pad_all(menu_ring, 0, LV_PART_MAIN);
	lv_obj_add_flag(menu_ring, LV_OBJ_FLAG_GESTURE_BUBBLE);
	lv_obj_remove_flag(menu_ring, LV_OBJ_FLAG_SCROLLABLE);
	lv_obj_remove_flag(menu_ring, LV_OBJ_FLAG_CLICKABLE);

	for (size_t i = 0; i < RADIAL_MENU_ITEMS_COUNT; i++) {
		item_size = ui_scale_px(RADIAL_MENU_ITEM_SIZE);
		radial_menu_items_obj[i] = lv_obj_create(scr);
		lv_obj_set_size(radial_menu_items_obj[i], item_size, item_size);
		lv_obj_set_style_radius(radial_menu_items_obj[i], LV_RADIUS_CIRCLE,
					LV_PART_MAIN);
		lv_obj_set_style_bg_color(radial_menu_items_obj[i],
					  lv_color_hex(0x12202E), LV_PART_MAIN);
		lv_obj_set_style_pad_all(radial_menu_items_obj[i], 0, LV_PART_MAIN);
		lv_obj_set_style_transform_zoom(radial_menu_items_obj[i],
						RADIAL_MENU_ZOOM_NORMAL,
						LV_PART_MAIN);
		radial_menu_item_zoom[i] = RADIAL_MENU_ZOOM_NORMAL;
		lv_obj_add_flag(radial_menu_items_obj[i], LV_OBJ_FLAG_GESTURE_BUBBLE);
		lv_obj_remove_flag(radial_menu_items_obj[i], LV_OBJ_FLAG_SCROLLABLE);
		lv_obj_add_event_cb(radial_menu_items_obj[i], radial_menu_item_event_cb,
				    LV_EVENT_CLICKED, NULL);

		radial_menu_symbols_obj[i] = lv_label_create(radial_menu_items_obj[i]);
		lv_label_set_text(radial_menu_symbols_obj[i], radial_menu_items[i].symbol);
		lv_obj_set_style_text_font(radial_menu_symbols_obj[i],
					   ui_scale_font_montserrat(16),
					   LV_PART_MAIN);
		lv_obj_add_flag(radial_menu_symbols_obj[i], LV_OBJ_FLAG_GESTURE_BUBBLE);
		lv_obj_center(radial_menu_symbols_obj[i]);
	}

	radial_menu_center_label = lv_label_create(scr);
	lv_obj_set_style_text_font(radial_menu_center_label,
				   ui_scale_font_montserrat(16), LV_PART_MAIN);
	lv_obj_set_style_text_color(radial_menu_center_label, lv_color_hex(0xF0F4F8),
				    LV_PART_MAIN);
	lv_obj_align(radial_menu_center_label, LV_ALIGN_CENTER, 0, ui_scale_px(2));

	if (radial_menu_active_idx >= RADIAL_MENU_ITEMS_COUNT) {
		radial_menu_active_idx = 0;
	}
	last_gesture_action_ms = 0;
	radial_menu_refresh(false);

	pairing_overlay = lv_obj_create(scr);
	lv_obj_set_size(pairing_overlay, ui_scale_px(180), ui_scale_px(80));
	lv_obj_align(pairing_overlay, LV_ALIGN_CENTER, 0, 0);
	lv_obj_set_style_radius(pairing_overlay, ui_scale_px(12), LV_PART_MAIN);
	lv_obj_set_style_bg_color(pairing_overlay, lv_color_hex(0x000000),
				  LV_PART_MAIN);
	lv_obj_set_style_bg_opa(pairing_overlay, LV_OPA_70, LV_PART_MAIN);
	lv_obj_set_style_border_width(pairing_overlay, ui_scale_px(2), LV_PART_MAIN);
	lv_obj_set_style_border_color(pairing_overlay, lv_color_hex(0xE7EEFF),
				      LV_PART_MAIN);
	lv_obj_set_style_pad_all(pairing_overlay, ui_scale_px(6), LV_PART_MAIN);
	lv_obj_remove_flag(pairing_overlay, LV_OBJ_FLAG_SCROLLABLE);
	lv_obj_add_flag(pairing_overlay, LV_OBJ_FLAG_HIDDEN);
	lv_obj_add_flag(pairing_overlay, LV_OBJ_FLAG_IGNORE_LAYOUT);

	lv_obj_t *pairing_title_label = lv_label_create(pairing_overlay);
	lv_label_set_text(pairing_title_label, "Pairing passkey");
	lv_obj_set_style_text_font(pairing_title_label, ui_scale_font_montserrat(14),
				   LV_PART_MAIN);
	lv_obj_set_style_text_color(pairing_title_label, lv_color_hex(0xDCE8F2),
				    LV_PART_MAIN);
	lv_obj_align(pairing_title_label, LV_ALIGN_TOP_MID, 0, 0);

	pairing_passkey_label = lv_label_create(pairing_overlay);
	lv_label_set_text(pairing_passkey_label, "------");
	lv_obj_set_style_text_font(pairing_passkey_label, ui_scale_font_montserrat(28),
				   LV_PART_MAIN);
	lv_obj_set_style_text_color(pairing_passkey_label, lv_color_hex(0xE7EEFF),
				    LV_PART_MAIN);
	lv_obj_align(pairing_passkey_label, LV_ALIGN_BOTTOM_MID, 0, 0);

	ui_screens_set_pairing_overlay(pairing_overlay, pairing_passkey_label);
}
```

## src/screen_menu.h
```c
// SPDX-License-Identifier: Apache-2.0

#ifndef SCREEN_MENU_H_
#define SCREEN_MENU_H_

#include <stdbool.h>
#include <stdint.h>
#include <lvgl.h>

#define UI_MENU_IDX_MUSIC 0
#define UI_MENU_IDX_BLUETOOTH 3

void ui_screen_menu_set_focus(uint8_t idx);
uint8_t ui_screen_menu_get_focus(void);
void ui_screen_menu_build(lv_obj_t *scr, bool clean_first);

#endif /* SCREEN_MENU_H_ */
```

## src/screen_music_player.h
```c
// SPDX-License-Identifier: Apache-2.0

#ifndef SCREEN_MUSIC_PLAYER_H_
#define SCREEN_MUSIC_PLAYER_H_

#include <stdbool.h>
#include <stdint.h>

typedef int (*ui_music_send_play_pause_cb_t)(bool play);
typedef int (*ui_music_send_usage_cb_t)(uint16_t usage);
typedef bool (*ui_music_bt_connected_cb_t)(void);

void ui_screen_music_player_init(ui_music_send_play_pause_cb_t play_pause_cb,
				 ui_music_send_usage_cb_t usage_cb,
				 ui_music_bt_connected_cb_t bt_connected_cb);
void ui_screen_music_player_show(void);

#endif /* SCREEN_MUSIC_PLAYER_H_ */
```

## src/ui_scale.c
```c
// SPDX-License-Identifier: Apache-2.0

#include "ui_scale.h"

#include <lvgl.h>
#include <stdbool.h>

static uint16_t ui_scale_permille = 1000U;

struct font_entry {
	uint8_t px;
	const lv_font_t *font;
};

static const struct font_entry montserrat_fonts[] = {
	{ 14, LV_FONT_DEFAULT },
#if defined(CONFIG_LV_FONT_MONTSERRAT_14) && CONFIG_LV_FONT_MONTSERRAT_14
	{ 14, &lv_font_montserrat_14 },
#endif
#if defined(CONFIG_LV_FONT_MONTSERRAT_16) && CONFIG_LV_FONT_MONTSERRAT_16
	{ 16, &lv_font_montserrat_16 },
#endif
#if defined(CONFIG_LV_FONT_MONTSERRAT_24) && CONFIG_LV_FONT_MONTSERRAT_24
	{ 24, &lv_font_montserrat_24 },
#endif
#if defined(CONFIG_LV_FONT_MONTSERRAT_28) && CONFIG_LV_FONT_MONTSERRAT_28
	{ 28, &lv_font_montserrat_28 },
#endif
#if defined(CONFIG_LV_FONT_MONTSERRAT_32) && CONFIG_LV_FONT_MONTSERRAT_32
	{ 32, &lv_font_montserrat_32 },
#endif
#if defined(CONFIG_LV_FONT_MONTSERRAT_40) && CONFIG_LV_FONT_MONTSERRAT_40
	{ 40, &lv_font_montserrat_40 },
#endif
#if defined(CONFIG_LV_FONT_MONTSERRAT_48) && CONFIG_LV_FONT_MONTSERRAT_48
	{ 48, &lv_font_montserrat_48 },
#endif
};

void ui_scale_refresh_for_active_screen(void)
{
	lv_obj_t *scr = lv_screen_active();
	int32_t w = 0;
	int32_t h = 0;
	int32_t w_scale;
	int32_t h_scale;
	int32_t min_scale;

	if (scr != NULL) {
		w = lv_obj_get_width(scr);
		h = lv_obj_get_height(scr);
	}

	if ((w <= 0) || (h <= 0)) {
		lv_display_t *disp = lv_display_get_default();

		if (disp != NULL) {
			w = lv_display_get_horizontal_resolution(disp);
			h = lv_display_get_vertical_resolution(disp);
		}
	}

	if ((w <= 0) || (h <= 0)) {
		ui_scale_permille = 1000U;
		return;
	}

	w_scale = (w * 1000) / UI_BASE_SIZE_PX;
	h_scale = (h * 1000) / UI_BASE_SIZE_PX;
	min_scale = (w_scale < h_scale) ? w_scale : h_scale;

	if (min_scale <= 0) {
		ui_scale_permille = 1000U;
		return;
	}

	ui_scale_permille = (uint16_t)min_scale;
}

int32_t ui_scale_px(int32_t value)
{
	int64_t scaled;
	int32_t abs_v = value;
	bool negative = false;

	if (value == 0) {
		return 0;
	}

	if (value < 0) {
		negative = true;
		abs_v = -value;
	}

	scaled = ((int64_t)abs_v * (int64_t)ui_scale_permille + 500LL) / 1000LL;
	if ((scaled == 0) && (abs_v > 0)) {
		scaled = 1;
	}

	return negative ? -(int32_t)scaled : (int32_t)scaled;
}

uint16_t ui_scale_permille_get(void)
{
	return ui_scale_permille;
}

const lv_font_t *ui_scale_font_montserrat(uint8_t base_px)
{
	size_t best_idx = 0U;
	uint16_t best_diff = UINT16_MAX;
	uint16_t target_px;

	if (base_px == 0U) {
		return LV_FONT_DEFAULT;
	}

	target_px = (uint16_t)(((uint32_t)base_px * ui_scale_permille + 500U) / 1000U);
	if (target_px == 0U) {
		target_px = 1U;
	}

	for (size_t i = 0; i < (sizeof(montserrat_fonts) / sizeof(montserrat_fonts[0]));
	     i++) {
		uint16_t font_px = montserrat_fonts[i].px;
		uint16_t diff = (font_px > target_px) ? (font_px - target_px) :
							(target_px - font_px);

		if (diff < best_diff) {
			best_diff = diff;
			best_idx = i;
		}
	}

	return montserrat_fonts[best_idx].font;
}
```

## src/ui_scale.h
```c
// SPDX-License-Identifier: Apache-2.0

#ifndef UI_SCALE_H_
#define UI_SCALE_H_

#include <stdint.h>
#include <lvgl.h>

#define UI_BASE_SIZE_PX 240

void ui_scale_refresh_for_active_screen(void);
int32_t ui_scale_px(int32_t value);
uint16_t ui_scale_permille_get(void);
const lv_font_t *ui_scale_font_montserrat(uint8_t base_px);

#endif /* UI_SCALE_H_ */
```

## src/ui_screens.c
```c
// SPDX-License-Identifier: Apache-2.0

#include "ui_screens.h"

#include <lvgl_zephyr.h>

#include "screen_menu.h"
#include "ui_scale.h"

static ui_bt_set_enabled_cb_t bt_set_enabled_cb;
static ui_bt_is_enabled_cb_t bt_is_enabled_cb;
static lv_obj_t *pairing_overlay;
static lv_obj_t *pairing_passkey_label;
static bool ui_ready;
static enum ui_screen_id active_screen = UI_SCREEN_MENU;

static bool pairing_overlay_is_valid(void)
{
	return (pairing_overlay != NULL) && (pairing_passkey_label != NULL) &&
	       lv_obj_is_valid(pairing_overlay) &&
	       lv_obj_is_valid(pairing_passkey_label);
}

static bool pairing_passkey_allowed(void)
{
	return active_screen == UI_SCREEN_BLUETOOTH;
}

static void pairing_overlay_create_on_active_screen(void)
{
	lv_obj_t *scr = lv_screen_active();
	lv_obj_t *title_label;
	int32_t border_w = ui_scale_px(2);

	if (border_w < 1) {
		border_w = 1;
	}

	pairing_overlay = lv_obj_create(scr);
	lv_obj_set_size(pairing_overlay, ui_scale_px(180), ui_scale_px(80));
	lv_obj_align(pairing_overlay, LV_ALIGN_CENTER, 0, 0);
	lv_obj_set_style_radius(pairing_overlay, ui_scale_px(12), LV_PART_MAIN);
	lv_obj_set_style_bg_color(pairing_overlay, lv_color_hex(0x000000),
				  LV_PART_MAIN);
	lv_obj_set_style_bg_opa(pairing_overlay, LV_OPA_70, LV_PART_MAIN);
	lv_obj_set_style_border_width(pairing_overlay, border_w, LV_PART_MAIN);
	lv_obj_set_style_border_color(pairing_overlay, lv_color_hex(0xE7EEFF),
				      LV_PART_MAIN);
	lv_obj_set_style_pad_all(pairing_overlay, ui_scale_px(6), LV_PART_MAIN);
	lv_obj_remove_flag(pairing_overlay, LV_OBJ_FLAG_SCROLLABLE);
	lv_obj_add_flag(pairing_overlay, LV_OBJ_FLAG_IGNORE_LAYOUT);

	title_label = lv_label_create(pairing_overlay);
	lv_label_set_text(title_label, "Pairing passkey");
	lv_obj_set_style_text_font(title_label, ui_scale_font_montserrat(14),
				   LV_PART_MAIN);
	lv_obj_set_style_text_color(title_label, lv_color_hex(0xDCE8F2),
				    LV_PART_MAIN);
	lv_obj_align(title_label, LV_ALIGN_TOP_MID, 0, 0);

	pairing_passkey_label = lv_label_create(pairing_overlay);
	lv_label_set_text(pairing_passkey_label, "------");
	lv_obj_set_style_text_font(pairing_passkey_label,
				   ui_scale_font_montserrat(28),
				   LV_PART_MAIN);
	lv_obj_set_style_text_color(pairing_passkey_label, lv_color_hex(0xE7EEFF),
				    LV_PART_MAIN);
	lv_obj_align(pairing_passkey_label, LV_ALIGN_BOTTOM_MID, 0, 0);
}

void ui_screens_init(ui_bt_set_enabled_cb_t set_enabled,
		     ui_bt_is_enabled_cb_t is_enabled)
{
	bt_set_enabled_cb = set_enabled;
	bt_is_enabled_cb = is_enabled;
}

void ui_screens_show_default(void)
{
	active_screen = UI_SCREEN_MENU;
	ui_screen_menu_build(lv_screen_active(), true);
	ui_ready = true;
}

void ui_screens_show_pairing_passkey(unsigned int passkey)
{
	if (!ui_ready || !pairing_passkey_allowed()) {
		return;
	}

	lvgl_lock();
	if (!pairing_overlay_is_valid()) {
		pairing_overlay = NULL;
		pairing_passkey_label = NULL;
		ui_scale_refresh_for_active_screen();
		pairing_overlay_create_on_active_screen();
	}
	lv_label_set_text_fmt(pairing_passkey_label, "%06u", passkey);
	lv_obj_clear_flag(pairing_overlay, LV_OBJ_FLAG_HIDDEN);
	lv_obj_move_foreground(pairing_overlay);
	lvgl_unlock();
}

void ui_screens_hide_pairing_passkey(void)
{
	if (!ui_ready) {
		return;
	}

	lvgl_lock();
	if (pairing_overlay_is_valid()) {
		lv_obj_add_flag(pairing_overlay, LV_OBJ_FLAG_HIDDEN);
	}
	lvgl_unlock();
}

void ui_screens_set_pairing_overlay(lv_obj_t *overlay, lv_obj_t *passkey_label)
{
	pairing_overlay = overlay;
	pairing_passkey_label = passkey_label;
}

void ui_screens_clear_pairing_overlay(void)
{
	pairing_overlay = NULL;
	pairing_passkey_label = NULL;
}

bool ui_screens_is_bluetooth_enabled(void)
{
	return (bt_is_enabled_cb != NULL) ? bt_is_enabled_cb() : false;
}

void ui_screens_request_bluetooth_enabled(bool enabled)
{
	if (bt_set_enabled_cb == NULL) {
		return;
	}

	bt_set_enabled_cb(enabled);
}

void ui_screens_set_active(enum ui_screen_id screen_id)
{
	active_screen = screen_id;
}

enum ui_screen_id ui_screens_get_active(void)
{
	return active_screen;
}
```
